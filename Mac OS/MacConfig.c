/************************************************************/
/****                                                    ****/
/****            Differentes fenetres de config          ****/
/****                                                    ****/
/************************************************************/

/** changes made by !ZAJC!/GDS (Marin Saric) can be found
	by searching for "!ZAJC!". The number after "!ZAJC!"
	indicates day,month and year when the change was made
**/

#include <Dialogs.h> // !ZAJC! 250998
#include <Sound.h>   // ...
// !ZAJC! happy start
# include <Fonts.h>
# include <QuickDraw.h>
# include <LowMem.h>
# include <Sound.h>
# include <Gestalt.h>
# include <TextUtils.h>
# include <Devices.h>
# include <ToolUtils.h>
// !ZAJC! happy end

#include "sysconfig.h"
#include "sysdeps.h"
#include <assert.h>

#include "config.h"
#include "options.h"
#include "threaddep/penguin.h"
#include "uae.h"
#include "gensound.h"
#include "sounddep/sound.h"
#include "events.h"
#include "memory.h"
#include "custom.h"
#include "serial.h"
#include "readcpu.h"
#include "newcpu.h"
#include "disk.h"
#include "debug.h"
#include "xwin.h"
#include "joystick.h"
#include "keybuf.h"
#include "gui.h"
#include "zfile.h"
#include "autoconf.h"
#include "osemu.h"
#include "osdep/exectasks.h"
#include "compiler.h"
#include "picasso96.h"
#include "uaeexe.h"
#include "getopt.h"

void graf_pref(void);
void CPU_pref(void);
void RAM_pref(void);
void sound_pref(void);
void running_pref(void);
void Menu_(void);

/* Bug ?? */
#define    fastmem_size   currprefs.fastmem_size
#define    a3000mem_size  currprefs.a3000mem_size
#define    z3fastmem_size currprefs.z3fastmem_size
#define    chipmem_size   currprefs.chipmem_size
#define    bogomem_size   currprefs.bogomem_size
#define    gfxmem_size    currprefs.gfxmem_size

/************************************************************/
/*** Prefs */
#define kMenuID 172
#define kCPU 1
#define kRAM 2
#define kGraf 3
#define kSound 4
#define kFS 5
#define kOK 6
#define kCancel 7

# include "Dialog Utilities.h" // !ZAJC! 250998
# include <stdio.h> // !ZAJC! ....

void Menu_(void)
{
	DialogPtr		mainDlg;
	short			itemHit=666;
	short			err=0;
	
	mainDlg = GetNewDialog( kMenuID, NULL, (WindowPtr)(-1L) );
	if ( !mainDlg ) ExitToShell();

	SetDialogDefaultItem(mainDlg, kOK);
	SetDialogCancelItem(mainDlg, kCancel);
	SetDialogTracksCursor(mainDlg, true);

	while ( itemHit != kOK)
	{
		ModalDialog(NULL,&itemHit);
			switch( itemHit )
			{
			case kCPU: CPU_pref(); break;
			case kRAM: RAM_pref(); break;
			case kGraf: graf_pref(); break;
			case kSound: sound_pref(); break;
			case kFS:/* FS_pref(); */ break;
			case kCancel: DisposeDialog(mainDlg); ExitToShell(); return; break;
			}
	}
	DisposeDialog( mainDlg );
}

#undef kMenuID
#undef kCPU
#undef kRAM
#undef kGraf
#undef kSound
#undef kFS
#undef kOK
#undef kCancel

/************************************************************/
/*** Grafix Prefs */
#define kGrafPrefID 168
#define kWidth 7
#define kHeight 8
#define kLowRes 9
#define kLineDbl 10
#define kCorrect 11
#define kCenterX_0 14
#define kCenterX_1 15
#define kCenterX_2 16
#define kCenterY_0 17
#define kCenterY_1 18
#define kCenterY_2 19
#define kBlit32 21
#define kBlitFast 22
#define kOK 3
#define kCancel 2
#define kText 4

#define SET_CENTER_X	SetOnOff(mainDlg,kCenterX_0,(currprefs.gfx_xcenter==0));\
						SetOnOff(mainDlg,kCenterX_1,(currprefs.gfx_xcenter==1));\
						SetOnOff(mainDlg,kCenterX_2,(currprefs.gfx_xcenter==2))

#define SET_CENTER_Y	SetOnOff(mainDlg,kCenterY_0,(currprefs.gfx_ycenter==0));\
						SetOnOff(mainDlg,kCenterY_1,(currprefs.gfx_ycenter==1));\
						SetOnOff(mainDlg,kCenterY_2,(currprefs.gfx_ycenter==2))

void graf_pref(void)
{
	DialogPtr		mainDlg;
	short			itemHit=666;
	short			error;
	
	mainDlg = GetNewDialog( kGrafPrefID, NULL, (WindowPtr)(-1L) );
	if ( !mainDlg ) ExitToShell();
		
	SetDialogDefaultItem(mainDlg, kOK);
	SetDialogCancelItem(mainDlg, kCancel);
	SetDialogTracksCursor(mainDlg, true);

failed:	
	SET_CENTER_X; SET_CENTER_Y;
	SetDialogNumberField(mainDlg,kWidth,currprefs.gfx_width);
	SetDialogNumberField(mainDlg,kHeight,currprefs.gfx_height);
	SetOnOff(mainDlg,kLowRes,currprefs.gfx_lores);
	SetOnOff(mainDlg,kLineDbl,currprefs.gfx_linedbl);
	SetOnOff(mainDlg,kCorrect,currprefs.gfx_correct_aspect);
	SetOnOff(mainDlg,kBlit32,currprefs.blits_32bit_enabled);
	SetOnOff(mainDlg,kBlitFast,currprefs.immediate_blits);
	error=0;
	itemHit = -1;
	
	while ( itemHit != kOK)
	{
		ModalDialog(NULL,&itemHit);
			switch( itemHit )
			{
			case kBlitFast: Toggle( mainDlg, kBlitFast ); break;
			case kBlit32: Toggle( mainDlg, kBlit32 ); break;
			case kLowRes: Toggle( mainDlg, kLowRes ); break;
			case kLineDbl: Toggle( mainDlg, kLineDbl ); break;
			case kCorrect: Toggle( mainDlg, kCorrect ); break;
			case kCenterX_0: currprefs.gfx_xcenter=0; SET_CENTER_X; break;
			case kCenterX_1: currprefs.gfx_xcenter=1; SET_CENTER_X; break;
			case kCenterX_2: currprefs.gfx_xcenter=2; SET_CENTER_X; break;
			case kCenterY_0: currprefs.gfx_ycenter=0; SET_CENTER_Y; break;
			case kCenterY_1: currprefs.gfx_ycenter=1; SET_CENTER_Y; break;
			case kCenterY_2: currprefs.gfx_ycenter=2; SET_CENTER_Y; break;
			case kCancel: DisposeDialog( mainDlg ); return; break;
			}
	}
	currprefs.gfx_width = GetDialogNumberField( mainDlg, kWidth );
	currprefs.gfx_height = GetDialogNumberField( mainDlg, kHeight );
	if(GetOnOff(mainDlg,kLowRes)) currprefs.gfx_lores=1; else currprefs.gfx_lores=0;
	if(GetOnOff(mainDlg,kLineDbl)) currprefs.gfx_linedbl=1; else currprefs.gfx_linedbl=0;
	if(GetOnOff(mainDlg,kCorrect)) currprefs.gfx_correct_aspect=1; else currprefs.gfx_correct_aspect=0;
	if(GetOnOff(mainDlg,kBlit32)) currprefs.blits_32bit_enabled=1; else currprefs.blits_32bit_enabled=0;
	if(GetOnOff(mainDlg,kBlitFast)) currprefs.immediate_blits=1; else currprefs.immediate_blits=0;
	
	if ((currprefs.gfx_width<320)||(currprefs.gfx_width>800)&&(!error)) {
		char szStr[40]; SysBeep(2); sprintf (szStr,"800 > gfx_width >320");
	  	SelectTextField(mainDlg,kWidth);
	  	SetText(mainDlg,kText,c2pstr(szStr)); error=1;
	  	if (currprefs.gfx_width<320) currprefs.gfx_width=320; else currprefs.gfx_width=800;
	  	}
	if ((currprefs.gfx_height<200)||(currprefs.gfx_height>600)&&(!error)) {
		char szStr[40]; SysBeep(2); sprintf (szStr,"600 > gfx_height >200");
	  	SelectTextField(mainDlg,kHeight);
	  	SetText(mainDlg,kText,c2pstr(szStr)); error=1;
	  	if (currprefs.gfx_height<200) currprefs.gfx_height=200; else currprefs.gfx_height=600;
	  	}
	if ((currprefs.gfx_height>300)&&(!currprefs.gfx_linedbl)&&(!error)) {
		char szStr[40]; SysBeep(2); sprintf (szStr,"you must activate linedbl");
		currprefs.gfx_linedbl=1; SetText(mainDlg,kText,c2pstr(szStr)); error=1;
		}

	if (error) goto failed;
	
	DisposeDialog( mainDlg );
}
#undef kGrafPrefID
#undef kWidth
#undef kHeight
#undef kLowRes
#undef kLineDbl
#undef kCorrect
#undef kCenterX_0
#undef kCenterX_1
#undef kCenterX_2
#undef kCenterY_0
#undef kCenterY_1
#undef kCenterY_2
#undef kBlit32
#undef kBlitFast
#undef kOK
#undef kCancel
#undef kText
#undef SET_CENTER_X
#undef SET_CENTER_Y

/************************************************************/
/*** CPU Prefs */
#define kCPUPrefID 166
#define k68000 7
#define k68010 8
#define k68020 9
#define k020FPU 10
#define kCompatible 2
#define k24bits 3
#define kOK 5
#define kCancel 4
#define kText 6

#define SET_CPU	SetOnOff(mainDlg,k68000,(currprefs.cpu_level==0));\
				SetOnOff(mainDlg,k68010,(currprefs.cpu_level==1));\
				SetOnOff(mainDlg,k68020,(currprefs.cpu_level==2));\
				SetOnOff(mainDlg,k020FPU,(currprefs.cpu_level==3))

void CPU_pref(void)
{
	DialogPtr		mainDlg;
	short			itemHit=666;
	short			error;
	
	mainDlg = GetNewDialog( kCPUPrefID, NULL, (WindowPtr)(-1L) );
	if ( !mainDlg ) ExitToShell();

	SetDialogDefaultItem(mainDlg, kOK);
	SetDialogCancelItem(mainDlg, kCancel);
	SetDialogTracksCursor(mainDlg, true);
	
	SET_CPU;
	SetOnOff(mainDlg,kCompatible,currprefs.cpu_compatible);
	
	if (currprefs.cpu_level>1) {
	ActivateControl( mainDlg, k24bits, 0x1 );
	SetOnOff(mainDlg,k24bits,currprefs.address_space_24);
	} else {
	ActivateControl( mainDlg, k24bits, 0x0 );
	SetOnOff(mainDlg,k24bits,0x1);
	}
	
failed:	
	error=0;
	itemHit = -1;
	
	while ( itemHit != kOK)
	{
		ModalDialog(NULL,&itemHit);
			switch( itemHit )
			{
			case k68000: currprefs.cpu_level=0; currprefs.address_space_24=1;SET_CPU; break;
			case k68010: currprefs.cpu_level=1; currprefs.address_space_24=1;SET_CPU; break;
			case k68020: currprefs.cpu_level=2; currprefs.address_space_24=0;SET_CPU; break;
			case k020FPU: currprefs.cpu_level=3;currprefs.address_space_24=0;SET_CPU; break;
			case kCompatible: Toggle( mainDlg, kCompatible ); break;
			case k24bits: Toggle( mainDlg, k24bits );currprefs.address_space_24^=1; break;
			case kCancel: DisposeDialog( mainDlg ); return; break;
			}
		if (currprefs.cpu_level>1) ActivateControl( mainDlg, k24bits, 0x1 );
		else ActivateControl( mainDlg, k24bits, 0x0 );
		SetOnOff(mainDlg,k24bits,currprefs.address_space_24);
	}
	if(GetOnOff(mainDlg,k24bits)) currprefs.address_space_24=1; else currprefs.address_space_24=0;
	if(GetOnOff(mainDlg,kCompatible)) currprefs.cpu_compatible=1; else currprefs.cpu_compatible=0;

	if (error) goto failed;
	
	DisposeDialog( mainDlg );

}
#undef kCPUPrefID
#undef k68000
#undef k68010
#undef k68020
#undef k020FPU
#undef kCompatible
#undef k24bits
#undef kOK
#undef kCancel
#undef kText
#undef SET_CPU

/************************************************************/
/*** RAM Prefs */
#define kRAMPrefID 167
#define kSlow 8
#define kChip 9
#define kFast 10
#define kZ3 16
#define kGrafix 17
#define kOK 3
#define kCancel 2
#define kText 4

void RAM_pref(void)
{
	DialogPtr		mainDlg;
	short			itemHit=666;
	short			err=0;
	char			szStr[80];
	
	mainDlg = GetNewDialog( kRAMPrefID, NULL, (WindowPtr)(-1L) );
	if ( !mainDlg ) ExitToShell();

	SetDialogDefaultItem(mainDlg, kOK);
	SetDialogCancelItem(mainDlg, kCancel);
	SetDialogTracksCursor(mainDlg, true);
	
failed:	
	if (err) SysBeep(1);
	SetDialogNumberField(mainDlg,kSlow,bogomem_size/0x40000); /* 256 */
	SetDialogNumberField(mainDlg,kChip,chipmem_size/0x80000); /* 512 */
	SetDialogNumberField(mainDlg,kFast,fastmem_size/0x100000); /* 1024 */
	SetDialogNumberField(mainDlg,kZ3,z3fastmem_size/0x100000); /* 1024 */
	SetDialogNumberField(mainDlg,kGrafix,gfxmem_size/0x100000); /* 1024 */

	err=0;
	itemHit = -1;
	
	while ( itemHit != kOK)
	{
		ModalDialog(NULL,&itemHit);
			switch( itemHit )
			{
			case kCancel: DisposeDialog( mainDlg ); return; break;
			}
	}
	
	z3fastmem_size = GetDialogNumberField( mainDlg, kZ3 ) * 0x100000;
	gfxmem_size = GetDialogNumberField( mainDlg, kGrafix ) * 0x100000;
	fastmem_size = GetDialogNumberField( mainDlg, kFast ) * 0x100000;
	bogomem_size = GetDialogNumberField( mainDlg, kSlow ) *  0x40000;
	chipmem_size = GetDialogNumberField( mainDlg, kChip ) *  0x80000;
	
	if ((chipmem_size&(chipmem_size-1))!= 0||chipmem_size<0x80000||chipmem_size>0x800000)
    {
	chipmem_size = 0x200000;
	sprintf (szStr, "Unsupported chipmem size!");
	SetText(mainDlg,kText,c2pstr(szStr));
	SelectTextField(mainDlg,kChip);
	err = 1;
    }
    if ((fastmem_size&(fastmem_size-1))!=0||(fastmem_size!=0&&(fastmem_size<0x100000||fastmem_size>0x800000)))
    {
	fastmem_size = 0;
	sprintf (szStr, "Unsupported fastmem size!");
	SetText(mainDlg,kText,c2pstr(szStr));
	SelectTextField(mainDlg,kFast);
	err = 1; 
    }
    if ((gfxmem_size&(gfxmem_size-1))!=0||(gfxmem_size!=0&&(gfxmem_size<0x100000||gfxmem_size>0x800000)))
    {
	gfxmem_size = 0;
	sprintf (szStr, "Unsupported graphics card memory size!");
	SetText(mainDlg,kText,c2pstr(szStr));
	SelectTextField(mainDlg,kGrafix);
	err = 1; 
    }
    if ((z3fastmem_size&(z3fastmem_size-1))!=0||(z3fastmem_size!=0&&(z3fastmem_size<0x100000||z3fastmem_size>0x4000000)))
    {
	z3fastmem_size = 0;
	sprintf (szStr, "Unsupported Zorro III fastmem size!");
	SetText(mainDlg,kText,c2pstr(szStr));
	SelectTextField(mainDlg,kZ3);
	err = 1; 
    }
    if (currprefs.address_space_24 && (gfxmem_size != 0 || z3fastmem_size != 0)) {
	z3fastmem_size = gfxmem_size = 0;
	sprintf (szStr, "Can't use a graphics card or Zorro III fastmem when using a 24 bits "
		 "address space - sorry.");
	SetText(mainDlg,kText,c2pstr(szStr));
	err = 1; 
    }
    if ((bogomem_size&(bogomem_size-1))!=0||(bogomem_size!=0&&(bogomem_size<0x80000||bogomem_size>0x100000)))
    {
	bogomem_size = 0;
	sprintf (szStr, "Unsupported bogomem size!");
	SetText(mainDlg,kText,c2pstr(szStr));
	SelectTextField(mainDlg,kSlow);
	err = 1;goto failed;
    }
    if (chipmem_size > 0x200000 && fastmem_size != 0) {
	sprintf (szStr, "You can't use fastmem and more than 2MB chip at the same time!");
	SetText(mainDlg,kText,c2pstr(szStr));
	fastmem_size = 0;
	SelectTextField(mainDlg,kFast);
	err = 1;
    }
    if (currprefs.cpu_level < 2 && z3fastmem_size > 0) {
	sprintf (szStr, "Z3 fast memory can't be used with a 68000/68010 emulation. It "
		 "requires a 68020 emulation. Turning off Z3 fast memory.");
	SetText(mainDlg,kText,c2pstr(szStr));
	z3fastmem_size = 0;
	SelectTextField(mainDlg,kZ3);
	err = 1;
    }
    if (currprefs.cpu_level < 2 && gfxmem_size > 0) {
	sprintf (szStr, "Picasso96 can't be used with a 68000/68010 emulation. It "
		 "requires a 68020 emulation. Turning off Picasso96.");
	SetText(mainDlg,kText,c2pstr(szStr));
	SelectTextField(mainDlg,kGrafix);
	gfxmem_size = 0;
	err = 1;
    }
    if (err) goto failed;
	DisposeDialog( mainDlg );
}
#undef kRAMPrefID
#undef kSlow
#undef kChip
#undef kFast
#undef kZ3
#undef kGrafix
#undef kOK
#undef kCancel
#undef kText

/************************************************************/
/*** SOUND Prefs */
#define kSoundPrefID 169
#define k8bits 2
#define k16bits 3
#define k44khz 4
#define k22khz 5
#define kE0 10
#define kE1 11
#define kE2 12
#define kE3 13
#define kStereo 14
#define kOK 7
#define kCancel 6
#define kText 8

#define SET_SOUND_BITS  SetOnOff(mainDlg,k8bits,(currprefs.sound_bits==8));\
						SetOnOff(mainDlg,k16bits,(currprefs.sound_bits==16))
						
#define SET_SOUND_FREQ	SetOnOff(mainDlg,k22khz,(currprefs.sound_freq==22050));\
						SetOnOff(mainDlg,k44khz,(currprefs.sound_freq==44100))
						
#define SET_SOUND_EMUL	SetOnOff(mainDlg,kE0,(currprefs.produce_sound==0));\
						SetOnOff(mainDlg,kE1,(currprefs.produce_sound==1));\
						SetOnOff(mainDlg,kE2,(currprefs.produce_sound==2));\
						SetOnOff(mainDlg,kE3,(currprefs.produce_sound==3))

void sound_pref(void)
{
	DialogPtr		mainDlg;
	short			itemHit=666;
	/*short			error;*/
	
	mainDlg = GetNewDialog( kSoundPrefID, NULL, (WindowPtr)(-1L) );
	if ( !mainDlg ) ExitToShell();
		
	SetDialogDefaultItem(mainDlg, kOK);
	SetDialogCancelItem(mainDlg, kCancel);
	SetDialogTracksCursor(mainDlg, true);
	SetOnOff(mainDlg,kStereo,currprefs.stereo);
	
/* failed: */
	SET_SOUND_BITS;
	SET_SOUND_FREQ;
	SET_SOUND_EMUL;

/* In fact I can't outpout 16bits sound , yet :-( */
	ActivateControl( mainDlg, k16bits, 0 );	
	currprefs.sound_bits=8;
	SET_SOUND_BITS;
/* I need to do A LOT OF work to support stereo */
	ActivateControl( mainDlg, kStereo, 0 );	
	currprefs.stereo=0;
/* End of Bug :-( */

	while ( itemHit != kOK)
	{
		ModalDialog(NULL,&itemHit);
			switch( itemHit )
			{
			case k8bits:  currprefs.sound_bits=8;  break;
			case k16bits: currprefs.sound_bits=16; break;
			case k44khz : currprefs.sound_freq=44100; break;
			case k22khz : currprefs.sound_freq=22050; break;
			case kE0 : currprefs.produce_sound=0; break;
			case kE1 : currprefs.produce_sound=1; break;
			case kE2 : currprefs.produce_sound=2; break;
			case kE3 : currprefs.produce_sound=3; break;
			case kStereo :	if (currprefs.stereo) currprefs.stereo=0;
							else currprefs.stereo=1; break;
			case kCancel: DisposeDialog( mainDlg ); return; break;
			}
	SET_SOUND_BITS; SET_SOUND_FREQ; SET_SOUND_EMUL;
	SetOnOff(mainDlg,kStereo,currprefs.stereo);
	}
	/*if (error) goto failed;*/
	DisposeDialog( mainDlg );
}
#undef SET_SOUND_BITS
#undef SET_SOUND_FREQ
#undef SET_SOUND_EMUL
#undef kSoundPrefID
#undef k8bits
#undef k16bits
#undef k44khz
#undef k22khz
#undef kE0
#undef kE1
#undef kE2
#undef kE3
#undef kStereo
#undef kOK
#undef kCancel
#undef kText

/************************************************************/
/*** ... Prefs */

#define kPrefInUAE 170
#define kFramerate 6
#define kCPUSpeed 8
#define kJnone 10
#define kJkeypad 11
#define kJkeyboard 12
#define kJarrow 13
#define kOutpoutSound 14
#define kOK 3
#define kCancel 2
#define kText 4

#define SET_JOY_BUT SetOnOff(mainDlg,kJkeypad,  (changed_prefs.fake_joystick==2+(3<<8)));\
					SetOnOff(mainDlg,kJarrow,   (changed_prefs.fake_joystick==2+(4<<8)));\
					SetOnOff(mainDlg,kJkeyboard,(changed_prefs.fake_joystick==2+(5<<8)));\
					SetOnOff(mainDlg,kJnone,    (changed_prefs.fake_joystick==2+(0<<8)))


void running_pref(void)
{
	DialogPtr		mainDlg;
	short			itemHit=666;
	short			err=0;
	char			szStr[80];
		
	mainDlg = GetNewDialog( kPrefInUAE, NULL, (WindowPtr)(-1L) );
	if ( !mainDlg ) ExitToShell();
		
	SetDialogDefaultItem(mainDlg, kOK);
	SetDialogCancelItem(mainDlg, kCancel);
	SetDialogTracksCursor(mainDlg, true);

	SetDialogNumberField(mainDlg,kFramerate,currprefs.framerate);
	SetDialogNumberField(mainDlg,kCPUSpeed,currprefs.m68k_speed);
	SetOnOff(mainDlg,kOutpoutSound,outpout_sound);
	
	changed_prefs.fake_joystick=currprefs.fake_joystick; //
failed:
	if (err) SysBeep(0);
	SET_JOY_BUT;
	err=0;
	itemHit=-1;

	while ( itemHit != kOK)
	{
		ModalDialog(NULL,&itemHit);
			switch( itemHit )
			{
			case kJkeypad: changed_prefs.fake_joystick=2+(3<<8); SET_JOY_BUT; break;
			case kJarrow: changed_prefs.fake_joystick=2+(4<<8); SET_JOY_BUT; break;
			case kJkeyboard: changed_prefs.fake_joystick=2+(5<<8); SET_JOY_BUT; break;
			case kJnone: changed_prefs.fake_joystick=2+(0<<8); SET_JOY_BUT; break;
			case kOutpoutSound: Toggle( mainDlg, kOutpoutSound ); break;
			case kCancel: DisposeDialog( mainDlg ); return; break;
			}
	}
	if(GetOnOff(mainDlg,kOutpoutSound)) outpout_sound=1; else outpout_sound=0;
	changed_prefs.m68k_speed=GetDialogNumberField( mainDlg, kCPUSpeed );
	changed_prefs.framerate=GetDialogNumberField( mainDlg, kFramerate );
	
    if (changed_prefs.m68k_speed < -1 || changed_prefs.m68k_speed > 20) {
	sprintf (szStr, "Bad value for m68k_speed,must be -1,0,or within 1..20");
	SetText(mainDlg,kText,c2pstr(szStr));
	SelectTextField(mainDlg,kCPUSpeed);
	err = 1;
    }
    if (changed_prefs.framerate < 1 || changed_prefs.framerate > 20) {
	sprintf (szStr, "Bad value for framerate,must in 1..20");
	SetText(mainDlg,kText,c2pstr(szStr));
	SelectTextField(mainDlg,kFramerate);
	err = 1;
    }
	if (err) goto failed;
	if (!outpout_sound) AsgardESS_Pause(true);
	else AsgardESS_Pause(false);
	check_prefs_changed_custom();
	check_prefs_changed_cpu();
	DisposeDialog( mainDlg );
}	

#undef SET_JOY_BUT
#undef kPrefInUAE
#undef kFramerate
#undef kCPUSpeed
#undef kJnone
#undef kJkeypad
#undef kJkeyboard
#undef kJarrow
#undef kOutpoutSound
#undef kOK
#undef kCancel
#undef kText
